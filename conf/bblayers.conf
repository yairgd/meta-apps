## conf/bblayers.conf
```bitbake
# POKY_BBLAYERS_CONF_VERSION is increased each time build/conf/bblayers.conf
# changes incompatibly
POKY_BBLAYERS_CONF_VERSION = "2"

BBPATH = "${TOPDIR}"
BBFILES ?= ""

BBLAYERS ?= " \
  /home/yair/yoctox86/poky/meta \
  /home/yair/yoctox86/poky/meta-poky \
  /home/yair/yoctox86/poky/meta-yocto-bsp \
  /home/yair/yoctox86/poky/meta-apps \
  /home/yair/yoctox86/poky/meta-openembedded/meta-oe \
  "
```

## conf/layer.conf
```bitbake
# We have a conf and classes directory, add to BBPATH
BBPATH .= ":${LAYERDIR}"

# We have a packages directory, add to BBFILES
BBFILES += "${LAYERDIR}/recipes-*/*/*.bb \
            ${LAYERDIR}/recipes-*/*/*.bbappend"

BBFILE_COLLECTIONS += "yair-gadelov"
BBFILE_PATTERN_yair-gadelov := "^${LAYERDIR}/"
BBFILE_PRIORITY_yair-gadelov = "8"

#LAYERSERIES_COMPAT_yair-gadelov
LICENSE_PATH += "${LAYERDIR}/licenses"
```
